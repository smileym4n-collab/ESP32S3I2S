## main/Kconfig.projbuild
```kconfig
menu "USB to I2S DAC"

    choice AUDIO_SAMPLE_RATE_CHOICE
        prompt "Default USB/I2S sample rate"
        default AUDIO_SAMPLE_RATE_48000
        help
            Default rate used at boot before the USB host chooses a rate.
            The firmware advertises 44.1, 48, 88.2, and 96 kHz.

        config AUDIO_SAMPLE_RATE_44100
            bool "44.1 kHz"

        config AUDIO_SAMPLE_RATE_48000
            bool "48 kHz"

        config AUDIO_SAMPLE_RATE_88200
            bool "88.2 kHz"

        config AUDIO_SAMPLE_RATE_96000
            bool "96 kHz"
    endchoice

    config AUDIO_SAMPLE_RATE
        int
        default 44100 if AUDIO_SAMPLE_RATE_44100
        default 48000 if AUDIO_SAMPLE_RATE_48000
        default 88200 if AUDIO_SAMPLE_RATE_88200
        default 96000 if AUDIO_SAMPLE_RATE_96000

    config AUDIO_I2S_PORT
        int "I2S port"
        default 0
        range 0 1

    config AUDIO_I2S_BCLK_GPIO
        int "I2S BCLK GPIO"
        default 4
        help
            Board GPIO4. Bit clock output to the DAC.

    config AUDIO_I2S_WS_GPIO
        int "I2S LRCK/WS GPIO"
        default 5
        help
            Board GPIO5. LRCK/word-select output to the DAC.

    config AUDIO_I2S_DATA_GPIO
        int "I2S DATA GPIO"
        default 6
        help
            Set this to the board's serial data output pin feeding the DAC.

    config AUDIO_I2S_MCLK_GPIO
        int "I2S external SCK/MCLK input GPIO"
        default 15
        help
            Board GPIO15. Selected oscillator from the 5PB1102PGGK clock
            buffer, used as the ESP32-S3 I2S external MCLK input when the
            ESP-IDF driver supports I2S_CLK_SRC_EXTERNAL.

    config AUDIO_OSC_SELECT_GPIO
        int "Oscillator select GPIO"
        default 7
        help
            Board GPIO7. LOW selects 22.5792 MHz for 44.1/88.2 kHz.
            HIGH selects 24.5760 MHz for 48/96 kHz.

    config BOARD_I2C_SDA_GPIO
        int "Reserved I2C SDA GPIO"
        default 8

    config BOARD_I2C_SCL_GPIO
        int "Reserved I2C SCL GPIO"
        default 9

    config BOARD_ATTINY_UART_TX_GPIO
        int "ATtiny1616 status UART TX GPIO"
        default 10
        help
            One-way 9600 baud UART TX to the ATtiny1616 RX. UART0 remains
            available for the normal debug/programming console.

    config BOARD_VBUS_SENSE_GPIO
        int "USB VBUS sense GPIO"
        default 13
        help
            Active-high USB host VBUS indication from the PCB resistor divider.
            This GPIO must never be connected directly to 5 V.

    config BOARD_MUTE_GPIO
        int "Active-high MUTE/status GPIO"
        default 35

    config BOARD_RATE_F3_GPIO
        int "Sample-rate status F3 GPIO"
        default 36

    config BOARD_RATE_F2_GPIO
        int "Sample-rate status F2 GPIO"
        default 37

    config BOARD_RATE_F1_GPIO
        int "Sample-rate status F1 GPIO"
        default 38

    config BOARD_RATE_F0_GPIO
        int "Sample-rate status F0 GPIO"
        default 39

    config AUDIO_OSC_SELECT_INVERT
        bool "Invert oscillator select GPIO polarity"
        default n
        help
            Enable this if the oscillator mux inputs are wired opposite to the
            default firmware assumption. With this enabled, 44.1/88.2 kHz
            drives the select GPIO HIGH and 48/96 kHz drives it LOW.

    config AUDIO_I2S_BCLK_INVERT
        bool "Invert I2S BCLK output"
        default n
        help
            Try this if the DAC samples serial data on the opposite BCLK edge
            from the ESP32-S3 default.

    config AUDIO_I2S_WS_INVERT
        bool "Invert I2S LRCK/WS output"
        default n
        help
            Try this if the DAC's left/right channel polarity is opposite.
            This normally swaps channels rather than causing silence.

    config AUDIO_I2S_DMA_DESC_NUM
        int "I2S DMA descriptor count"
        default 8
        range 4 16

    config AUDIO_I2S_DMA_FRAME_NUM
        int "I2S DMA frames per descriptor"
        default 240
        range 48 511
        help
            240 frames is 5 ms at 48 kHz and 2.5 ms at 96 kHz. Keep this
            below the ESP-IDF I2S driver's 511-frame limit.

    config AUDIO_STREAM_BUFFER_MS
        int "USB-to-I2S software buffer in ms"
        default 128
        range 20 250

    config AUDIO_PREFILL_MS
        int "Audio prefill before I2S start in ms"
        default 40
        range 2 100

    config AUDIO_IDLE_STOP_MS
        int "Stop I2S after no USB audio for this many ms"
        default 1000
        range 50 2000

    config AUDIO_TEST_TONE
        bool "Generate 1 kHz I2S test tone instead of USB audio"
        default n
        help
            Bypass USB audio data and write a simple stereo test tone to the
            I2S DAC path. Use this only for board bring-up diagnostics.

endmenu
```

## sdkconfig.defaults.96k
```kconfig
CONFIG_IDF_TARGET="esp32s3"

CONFIG_ESPTOOLPY_FLASHSIZE_16MB=y
CONFIG_SPIRAM=y
CONFIG_SPIRAM_MODE_OCT=y
CONFIG_ESP_DEFAULT_CPU_FREQ_MHZ_240=y
CONFIG_FREERTOS_HZ=1000

CONFIG_UAC_TUSB_MANUFACTURER="Custom"
CONFIG_UAC_TUSB_PRODUCT="ESP32-S3 USB-I2S DAC"
CONFIG_UAC_TUSB_SERIAL_NUM="ESP32S3I2S001"
CONFIG_UAC_SPEAKER_CHANNEL_NUM=2
CONFIG_UAC_MIC_CHANNEL_NUM=0
CONFIG_UAC_SAMPLE_RATE=96000
CONFIG_UAC_SPK_INTERVAL_MS=10
CONFIG_UAC_SPK_NEW_PLAY_INTERVAL=100
CONFIG_UAC_TINYUSB_TASK_PRIORITY=7
CONFIG_UAC_SPK_TASK_PRIORITY=7

CONFIG_AUDIO_SAMPLE_RATE_96000=y
CONFIG_AUDIO_BIT_DEPTH_16=y
CONFIG_AUDIO_I2S_BCLK_GPIO=-1
CONFIG_AUDIO_I2S_WS_GPIO=-1
CONFIG_AUDIO_I2S_DATA_GPIO=-1
CONFIG_AUDIO_I2S_DMA_DESC_NUM=8
CONFIG_AUDIO_I2S_DMA_FRAME_NUM=240
CONFIG_AUDIO_STREAM_BUFFER_MS=64
CONFIG_AUDIO_PREFILL_MS=20
CONFIG_AUDIO_IDLE_STOP_MS=250
```
